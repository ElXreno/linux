## Documentation/devicetree/bindings/sound/nxp,tfa9873.yaml
```yaml
# SPDX-License-Identifier: (GPL-2.0-only OR BSD-2-Clause)
%YAML 1.2
---
$id: http://devicetree.org/schemas/sound/nxp,tfa9873.yaml#
$schema: http://devicetree.org/meta-schemas/core.yaml#

title: NXP/Goodix TFA9873 Audio Amplifier

maintainers:
  - ElXreno <elxreno@gmail.com>

allOf:
  - $ref: dai-common.yaml#

properties:
  compatible:
    const: nxp,tfa9873

  reg:
    maxItems: 1

  '#sound-dai-cells':
    const: 0

  sound-name-prefix: true

  nxp,tdm-speaker-slot:
    $ref: /schemas/types.yaml#/definitions/uint32
    maximum: 15
    default: 0
    description: TDM slot the amplifier takes its speaker channel from.

required:
  - compatible
  - reg
  - '#sound-dai-cells'

additionalProperties: false

examples:
  - |
    i2c {
      #address-cells = <1>;
      #size-cells = <0>;

      audio-codec@34 {
        compatible = "nxp,tfa9873";
        reg = <0x34>;
        sound-name-prefix = "Top";
        #sound-dai-cells = <0>;
      };

      audio-codec@35 {
        compatible = "nxp,tfa9873";
        reg = <0x35>;
        nxp,tdm-speaker-slot = <1>;
        sound-name-prefix = "Bottom";
        #sound-dai-cells = <0>;
      };
    };
```
